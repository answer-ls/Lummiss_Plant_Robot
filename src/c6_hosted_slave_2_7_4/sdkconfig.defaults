## src/c6_hosted_slave_2_7_4/sdkconfig.defaults
```kconfig
# BT Configuration
CONFIG_BT_ENABLED=y
CONFIG_BT_CONTROLLER_ONLY=y

# OTA
CONFIG_ESPTOOLPY_FLASHSIZE_4MB=y
CONFIG_PARTITION_TABLE_TWO_OTA=y

# OS
CONFIG_FREERTOS_HZ=1000
CONFIG_ESP_WIFI_NVS_ENABLED=y
CONFIG_BOOTLOADER_COMPILER_OPTIMIZATION_PERF=y

#Disable enterprise support by default
CONFIG_ESP_WIFI_ENTERPRISE_SUPPORT=n

# 诊断 C6 的 SDIO 队列限流和 Wi-Fi TX API 重试；每 5 秒汇总一次。
CONFIG_ESP_PKT_STATS=y
CONFIG_ESP_PKT_STATS_INTERVAL_SEC=5
```

## src/demo/components/anim_bin_player/Kconfig.projbuild
```kconfig
menu "Lummiss 动画播放器"

config LUMMISS_ANIM_FIRST_FRAME_ONLY
    bool "仅显示 LUM1 第一帧"
    default n
    help
        仅用于 Stage 6 开发验证。播放器解析 BIN 后只显示第 0 帧，直到收到
        stop。正常连续播放固件必须关闭此开关。

endmenu
```

## src/demo/components/board/Kconfig.projbuild
```kconfig
menu "Lummiss heap diagnostics"
    config H264_FRAGMENT_FOCUSED
        bool "Enable bounded reserve-region owner diagnosis"
        default y
        help
            Trace until first H264 open. Print at most 12 owner groups and
            16 boundary allocations, without the complete heap dump.
    config H264_FRAGMENT_VERBOSE
        bool "Enable one-shot full H264 heap layout and allocation trace"
        default n
        help
            Diagnostic only. Prints hundreds of heap blocks and allocation
            callers before the first H264 open. Keep disabled for normal use.
endmenu
```

## src/demo/components/provisioning/Kconfig.projbuild
```kconfig
menu "Lummiss BLE provisioning"

config LUMMISS_FORCE_BLE_PROVISIONING
    bool "Force BLE provisioning even when Wi-Fi credentials exist"
    default n
    help
        Development-only switch used to validate BLE provisioning without erasing
        the Wi-Fi credentials stored by the ESP32-C6. Keep this disabled in normal
        firmware builds.

endmenu
```

## src/demo/components/video_streamer/Kconfig
```kconfig
menu "RTC 内存诊断"
    config RTC_MEM_DIAG_640P
        bool "RTC A/B：使用 640x480@15、900 kbps"
        default n
        help
            仅用于与默认 1280x720@20 比较 H264 reference 和 DMA 内存。
endmenu
```

## src/demo/components/xiaozhi_audio/Kconfig.projbuild
```kconfig
menu "Audio lifecycle diagnostics"
    config WAKE_CLEANUP_TRANSIENT
        bool "Release INTERNAL cleanup task after model teardown (B)"
        default y
        help
            Enable B: dynamically allocate the INTERNAL lifecycle task and
            synchronously delete it after teardown. Disable for A: retain
            the original static INTERNAL stack and task for comparison.
endmenu
```

## src/hardware_audio_test/sdkconfig.defaults
```kconfig
CONFIG_IDF_TARGET="esp32p4"
CONFIG_ESP32P4_REV_MIN_301=y
CONFIG_ESPTOOLPY_FLASHSIZE_16MB=y
CONFIG_ESPTOOLPY_FLASHMODE_DIO=y
CONFIG_SPIRAM=y
CONFIG_SPIRAM_SPEED_200M=y
CONFIG_SPIRAM_USE_CAPS_ALLOC=y
CONFIG_ESP_MAIN_TASK_STACK_SIZE=8192
CONFIG_ESP_CONSOLE_UART_DEFAULT=y
CONFIG_ESP_CONSOLE_UART_BAUDRATE=115200
CONFIG_ESP_CONSOLE_SECONDARY_NONE=y
```

## src/sd_raw_minimal/sdkconfig.defaults
```kconfig
CONFIG_IDF_TARGET="esp32p4"
CONFIG_ESP_TASK_WDT_TIMEOUT_S=15
CONFIG_ESP_TASK_WDT_PANIC=n
```

## src/sdspi_idf_reference/sdkconfig.defaults
```kconfig
CONFIG_IDF_TARGET="esp32p4"
CONFIG_ESPTOOLPY_FLASHMODE_DIO=y
CONFIG_ESPTOOLPY_FLASHFREQ_80M=y
CONFIG_ESPTOOLPY_FLASHSIZE_16MB=y
CONFIG_EXAMPLE_PIN_CLK=42
CONFIG_EXAMPLE_PIN_MOSI=43
CONFIG_EXAMPLE_PIN_MISO=41
CONFIG_EXAMPLE_PIN_CS=44
CONFIG_FATFS_VFS_FSTAT_BLKSIZE=4096
CONFIG_ESP_MAIN_TASK_STACK_SIZE=8192
CONFIG_FREERTOS_HZ=1000
```

## src/sdspi_official_test/sdkconfig.defaults
```kconfig
CONFIG_IDF_TARGET="esp32p4"
CONFIG_ESP32P4_SELECTS_REV_LESS_V3=y
CONFIG_ESP32P4_REV_MIN_100=y
CONFIG_ESPTOOLPY_FLASHMODE_DIO=y
CONFIG_ESPTOOLPY_FLASHFREQ_80M=y
CONFIG_ESPTOOLPY_FLASHSIZE_16MB=y
CONFIG_FATFS_LFN_HEAP=y
CONFIG_FATFS_MAX_LFN=255
```

## src/xiaozhi_dual_mic_reference_test - v3.2/sdkconfig.defaults
```kconfig
CONFIG_IDF_TARGET="esp32p4"
CONFIG_ESP32P4_REV_MIN_301=y
CONFIG_ESPTOOLPY_FLASHSIZE_16MB=y
CONFIG_SPIRAM=y
CONFIG_SPIRAM_SPEED_200M=y
CONFIG_SPIRAM_USE_MALLOC=y
CONFIG_SPIRAM_MALLOC_ALWAYSINTERNAL=0
CONFIG_SPIRAM_MALLOC_RESERVE_INTERNAL=200000
CONFIG_SPIRAM_ALLOW_STACK_EXTERNAL_MEMORY=y
CONFIG_ESP_MAIN_TASK_STACK_SIZE=8192
CONFIG_PARTITION_TABLE_CUSTOM=y
CONFIG_PARTITION_TABLE_CUSTOM_FILENAME="partitions.csv"
CONFIG_SR_WN_WN9_NIHAOXIAOZHI_TTS=y
CONFIG_XIAOZHI_APP_UI_LANGUAGE_SIMPLIFIED_CHINESE=y
CONFIG_XIAOZHI_APP_TRANSPORT_AUTO=y
CONFIG_MBEDTLS_CERTIFICATE_BUNDLE=y
CONFIG_FREERTOS_HZ=1000
CONFIG_ESP_HOSTED_ENABLED=y
CONFIG_ESP_HOSTED_P4_DEV_BOARD_NONE=y
CONFIG_ESP_HOSTED_PRIV_SDIO_OPTION=y
CONFIG_ESP_HOSTED_PRIV_SPI_HD_OPTION=y
CONFIG_ESP_HOSTED_SDIO_HOST_INTERFACE=y
CONFIG_ESP_HOSTED_IDF_SLAVE_TARGET="esp32c6"
CONFIG_ESP_HOSTED_SDIO_RESET_ACTIVE_HIGH=y
CONFIG_ESP_HOSTED_SDIO_OPTIMIZATION_RX_STREAMING_MODE=y
CONFIG_ESP_HOSTED_SDIO_SLOT_1=y
CONFIG_ESP_HOSTED_SDIO_SLOT=1
CONFIG_ESP_HOSTED_SDIO_4_BIT_BUS=y
CONFIG_ESP_HOSTED_SDIO_BUS_WIDTH=4
CONFIG_ESP_HOSTED_SDIO_CLOCK_FREQ_KHZ=10000
CONFIG_ESP_HOSTED_SDIO_CMD_GPIO_RANGE_MIN=0
CONFIG_ESP_HOSTED_SDIO_CMD_GPIO_RANGE_MAX=100
CONFIG_ESP_HOSTED_SDIO_CLK_GPIO_RANGE_MIN=0
CONFIG_ESP_HOSTED_SDIO_CLK_GPIO_RANGE_MAX=100
CONFIG_ESP_HOSTED_SDIO_D0_GPIO_RANGE_MIN=0
CONFIG_ESP_HOSTED_SDIO_D0_GPIO_RANGE_MAX=100
CONFIG_ESP_HOSTED_SDIO_D1_GPIO_RANGE_MIN=0
CONFIG_ESP_HOSTED_SDIO_D1_GPIO_RANGE_MAX=100
CONFIG_ESP_HOSTED_SDIO_D2_GPIO_RANGE_MIN=0
CONFIG_ESP_HOSTED_SDIO_D2_GPIO_RANGE_MAX=100
CONFIG_ESP_HOSTED_SDIO_D3_GPIO_RANGE_MIN=0
CONFIG_ESP_HOSTED_SDIO_D3_GPIO_RANGE_MAX=100
CONFIG_ESP_HOSTED_SDIO_RESET_SLAVE_GPIO_MIN=0
CONFIG_ESP_HOSTED_SDIO_RESET_SLAVE_GPIO_MAX=100
CONFIG_ESP_HOSTED_PRIV_SDIO_PIN_CMD_SLOT_1=19
CONFIG_ESP_HOSTED_PRIV_SDIO_PIN_CLK_SLOT_1=18
CONFIG_ESP_HOSTED_PRIV_SDIO_PIN_D0_SLOT_1=14
CONFIG_ESP_HOSTED_PRIV_SDIO_PIN_D1_4BIT_BUS_SLOT_1=15
CONFIG_ESP_HOSTED_PRIV_SDIO_PIN_D2_4BIT_BUS_SLOT_1=16
CONFIG_ESP_HOSTED_PRIV_SDIO_PIN_D3_4BIT_BUS_SLOT_1=17
CONFIG_ESP_HOSTED_SDIO_GPIO_RESET_SLAVE=54
CONFIG_ESP_HOSTED_SDIO_PIN_CMD=19
CONFIG_ESP_HOSTED_SDIO_PIN_CLK=18
CONFIG_ESP_HOSTED_SDIO_PIN_D0=14
CONFIG_ESP_HOSTED_SDIO_PRIV_PIN_D1_4BIT_BUS=15
CONFIG_ESP_HOSTED_SDIO_PIN_D2=16
CONFIG_ESP_HOSTED_SDIO_PIN_D3=17
CONFIG_ESP_HOSTED_SDIO_PIN_D1=15
CONFIG_ESP_HOSTED_SDIO_TX_Q_SIZE=20
CONFIG_ESP_HOSTED_SDIO_RX_Q_SIZE=20
CONFIG_ESP_HOSTED_SDIO_RESET_DELAY_MS=1500
CONFIG_ESP_HOSTED_SLAVE_RESET_ON_EVERY_HOST_BOOTUP=y
CONFIG_ESP_HOSTED_GPIO_SLAVE_RESET_SLAVE=54
CONFIG_ESP_HOSTED_ENABLE_BT_NIMBLE=y
CONFIG_ESP_HOSTED_NIMBLE_HCI_VHCI=y
CONFIG_ESP_HOSTED_RPC_TASK_STACK=4096
CONFIG_ESP_HOSTED_DFLT_TASK_STACK=3072
CONFIG_ESP_HOSTED_ENABLE_ITWT=y
CONFIG_ESP_HOSTED_USE_MEMPOOL=y
CONFIG_ESP_HOSTED_MAX_SIMULTANEOUS_SYNC_RPC_REQUESTS=5
CONFIG_ESP_HOSTED_MAX_SIMULTANEOUS_ASYNC_RPC_REQUESTS=5
CONFIG_ESP_HOSTED_CLI_ENABLED=y
CONFIG_ESP_HOSTED_HOST_TO_ESP_WIFI_DATA_THROTTLE=y
CONFIG_ESP_HOSTED_PRIV_WIFI_TX_SDIO_HIGH_THRESHOLD=80
CONFIG_ESP_HOSTED_TO_WIFI_DATA_THROTTLE_HIGH_THRESHOLD=80
CONFIG_ESP_HOSTED_TO_WIFI_DATA_THROTTLE_LOW_THRESHOLD=60
CONFIG_ESP_WIFI_REMOTE_ENABLED=y
CONFIG_ESP_WIFI_REMOTE_IDF_SPECIFIC_ADDED=y
CONFIG_ESP_WIFI_REMOTE_LIBRARY_HOSTED=y
CONFIG_ESP_WIFI_REMOTE_EAP_ENABLED=y

CONFIG_SLAVE_IDF_TARGET_ESP32C6=y
```

## src/xiaozhi_dual_mic_reference_test/main/Kconfig.projbuild
```kconfig
menu "Reference board"
config REFERENCE_WIFI_SSID
    string "Test WiFi SSID (empty: saved STA configuration)"
    default ""
config REFERENCE_WIFI_PASSWORD
    string "Test WiFi password"
    default ""
endmenu
```
